#include <screen-defines.h>
#include "stdio.h"

// TODO: could do the thing where you write everything to a buffer and print it at once

static uint8_t initd[] = {
        HX8357_SWRESET,
        0x80 + 100 / 5, // Soft reset, then delay 10 ms
        HX8357D_SETC,
        3,
        0xFF,
        0x83,
        0x57,
        0xFF,
        0x80 + 500 / 5, // No command, just delay 300 ms
        HX8357_SETRGB,
        4,
        0x80,
        0x00,
        0x06,
        0x06, // 0x80 enables SDO pin (0x00 disables)
        HX8357D_SETCOM,
        1,
        0x25, // -1.52V
        HX8357_SETOSC,
        1,
        0x68, // Normal mode 70Hz, Idle mode 55 Hz
        HX8357_SETPANEL,
        1,
        0x05, // BGR, Gate direction swapped
        HX8357_SETPWR1,
        6,
        0x00, // Not deep standby
        0x15, // BT
        0x1C, // VSPR
        0x1C, // VSNR
        0x83, // AP
        0xAA, // FS
        HX8357D_SETSTBA,
        6,
        0x50, // OPON normal
        0x50, // OPON idle
        0x01, // STBA
        0x3C, // STBA
        0x1E, // STBA
        0x08, // GEN
        HX8357D_SETCYC,
        7,
        0x02, // NW 0x02
        0x40, // RTN
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        0x78, // GDOFF
        HX8357D_SETGAMMA,
        34,
        0x02,
        0x0A,
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        0x01,
        HX8357_COLMOD,
        1,
        0x55, // 16 bit
        HX8357_MADCTL,
        1,
        0xC0,
        HX8357_TEON,
        1,
        0x00, // TW off
        HX8357_TEARLINE,
        2,
        0x00,
        0x02,
        HX8357_SLPOUT,
        0x80 + 150 / 5, // Exit Sleep, then delay 150 ms
        HX8357_DISPON,
        0x80 + 50 / 5, // Main screen turn on, delay 50 ms
        0,             // END OF COMMAND LIST
};

static const unsigned char font[] = {
    0x00, 0x00, 0x00, 0x00, 0x00, 0x3E, 0x5B, 0x4F, 0x5B, 0x3E, 0x3E, 0x6B,
    0x4F, 0x6B, 0x3E, 0x1C, 0x3E, 0x7C, 0x3E, 0x1C, 0x18, 0x3C, 0x7E, 0x3C,
    0x18, 0x1C, 0x57, 0x7D, 0x57, 0x1C, 0x1C, 0x5E, 0x7F, 0x5E, 0x1C, 0x00,
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    0x14, 0x08, 0x55, 0x00, 0x55, 0x00, 0x55, // #176 (25% block) missing in old
                                              // code
    0xAA, 0x55, 0xAA, 0x55, 0xAA,             // 50% block
    0xFF, 0x55, 0xFF, 0x55, 0xFF,             // 75% block
    0x00, 0x00, 0x00, 0xFF, 0x00, 0x10, 0x10, 0x10, 0xFF, 0x00, 0x14, 0x14,
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    0x3C, 0x00, 0x00, 0x00, 0x00, 0x00 // #255 NBSP
};

// convert a little endian 16 bit number to big endian
uint16_t big(uint16_t original) {
	uint16_t result = original << 8;
	result |= original >> 8;
	return result;
}

// send an SPI command in the correct format
void sendCommand(SPI_HandleTypeDef* spi, uint8_t commandByte, uint8_t *dataBytes, uint16_t numDataBytes) {
	//printf("Sending command: cmd %x, args %d\r\n", commandByte, numDataBytes);

	// first send the command byte
	HAL_GPIO_WritePin(GPIOF, GPIO_PIN_12, GPIO_PIN_RESET); // pull DC low
	HAL_SPI_Transmit(spi, &commandByte, 1, 100); // write the byte
	HAL_GPIO_WritePin(GPIOF, GPIO_PIN_12, GPIO_PIN_SET); // pull DC back high

	HAL_SPI_Transmit(spi, dataBytes, numDataBytes, 100);
}

// x1 <= x2, y1 <= y2
void sendBlock(SPI_HandleTypeDef* spi, uint16_t x1, uint16_t x2, uint16_t y1, uint16_t y2, uint16_t value) {
	uint32_t amount = (uint32_t)(x2-x1+1) * (uint32_t)(y2-y1+1); // amount of pixels to send
	uint16_t widthSpan[2] = {big(x1), big(x2)};
	uint16_t heightSpan[2] = {big(y1), big(y2)};
	sendCommand(spi, HX8357_CASET, (uint8_t*)widthSpan, 4);
	sendCommand(spi, HX8357_PASET, (uint8_t*)heightSpan, 4);

	// This sends the pixels. There are likely more than 2^16 to send,
	// however the HAL SPI can only send 2^16 at a time, so break up the
	// transaction into chunks of 2^16. Don't send one at a time because that
	// is much much slower. It is still fairly slow so in the future I
	// could try to optimize it.
	sendCommand(spi, HX8357_RAMWR, NULL, 0);
	uint16_t fullLength = 32767; // maximum amount of pixels that can be sent at once
	uint16_t buffer[fullLength];
	for (uint16_t i = 0; i < fullLength; i++) buffer[i] = big(value); // fill the buffer
	uint32_t fullTransactions = amount / fullLength; // amount of full transactions to send
	uint16_t weirdLength = amount % fullLength; // one transaction will be a different amount
	if (weirdLength != 0) {
		HAL_SPI_Transmit(spi, (uint8_t*)&buffer, weirdLength * 2, 100);
	}
	for (uint32_t i = 0; i < fullTransactions; i++) {
		HAL_SPI_Transmit(spi, (uint8_t*)&buffer, fullLength * 2, 100);
	}
}

// (x, y) is the bottom left corner of the character
// size_x, size_y is magnification factor
void sendCharacter(SPI_HandleTypeDef* spi, uint16_t x, uint16_t y, char c, uint16_t color, uint8_t size_x, uint8_t size_y) {
	// taken from https://github.com/adafruit/Adafruit-GFX-Library/blob/master/Adafruit_GFX.cpp#L1150-L1166
    for (int8_t i = 0; i < 5; i++) { // Char bitmap = 5 columns
    	uint8_t line = font[c * 5 + i];
    	for (int8_t j = 0; j < 8; j++, line >>= 1) {
    		if (line & 1) {
    			uint16_t x1 = x + 7 * size_x - j * size_x;
    			uint16_t y1 = y + i * size_y;
    			uint16_t x2 = x1 + size_x - 1;
    			uint16_t y2 = y1 + size_y - 1;
    			sendBlock(spi, x1, x2, y1, y2, color);
    		}
    	}
    }
}

void sendString(SPI_HandleTypeDef* spi, uint16_t x, uint16_t y, char* s, uint16_t color, uint8_t size_x, uint8_t size_y) {
	uint16_t width = (5 + 1) * size_y; // because character has 5 columns, +1 to add space between characters
	for (uint8_t i = 0; s[i] != 0; i++) {
		uint16_t offset = y + i * width;
		if (offset + width > 479) return; // off the end of the screen
		sendCharacter(spi, x, offset, s[i], color, size_x, size_y);
	}
}

void initialize_screen(SPI_HandleTypeDef* spi) {
	printf("Starting initialization.\r\n");

	// hardware reset the display
	HAL_GPIO_WritePin(GPIOF, GPIO_PIN_13, GPIO_PIN_RESET);
	HAL_Delay(250);
	HAL_GPIO_WritePin(GPIOF, GPIO_PIN_13, GPIO_PIN_SET);

	uint8_t *addr = initd;
	uint8_t cmd, x, numArgs;
	while ((cmd = *(addr++)) > 0) { // '0' command ends list
		x = *(addr++);
		numArgs = x & 0x7F;
		if (cmd != 0xFF) { // '255' is ignored
		  if (x & 0x80) {  // If high bit set, numArgs is a delay time
			sendCommand(spi, cmd, NULL, 0);
		  } else {
			sendCommand(spi, cmd, addr, numArgs);
			addr += numArgs;
		  }
		}
		if (x & 0x80) {       // If high bit set...
		  HAL_Delay(numArgs * 5); // numArgs is actually a delay time (5ms units)
		}
	}
}

void draw(SPI_HandleTypeDef* spi) {
	printf("Sending pixels.\r\n");

	const uint16_t yend = 479;
	const uint16_t xend = 319;

	// use https://rgbcolorpicker.com/565 to find pixel values
	sendBlock(spi, 0, xend, 0, yend, 0);
	sendBlock(spi, 25, 25+75, 50, yend-50, 0x2dab);
	sendBlock(spi, 25+75+25, 25+75+25+75, 50, yend-50, 0x2dab);

	sendString(spi, xend-70, 20, "Delivering for?", 0xffff, 5, 5);
	sendString(spi, 25+75+25 + 10, 50 + 10, "B. Obama", 0x0, 5, 5);
	sendString(spi, 25 + 10, 50 + 10, "Benton E.", 0x0, 5, 5);
	//sendBlock(spi, 0, 0, 0, 0, 0x17e0);
	//sendBlock(spi, xend, xend, yend, yend, 0xf880);
}



